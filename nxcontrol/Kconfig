## nxcontrol/Kconfig
```kconfig
#
# For a description of the syntax of this configuration file,
# see the file kconfig-language.txt in the NuttX tools repository.
#

config NXCONTROL
	tristate "Nxcontrol app"
	default n
	---help---
		Enable the Nxcontrol app

if NXCONTROL

config NXCONTROL_PROGNAME
	string "Program name"
	default "nxctl"
	---help---
		This is the name of the program that will be used when the NSH ELF
		program is installed.

config NXCONTROL_PRIORITY
	int "NXCONTROL task priority"
	default 100

config NXCONTROL_STACKSIZE
	int "Nxcontrol stack size"
	default DEFAULT_TASK_STACKSIZE

endif
```
